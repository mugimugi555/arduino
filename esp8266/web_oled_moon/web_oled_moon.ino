#include <Wire.h>
#include <Adafruit_GFX.h>
#include <Adafruit_SSD1306.h>
#include <ESP8266WiFi.h>
#include <ESP8266HTTPClient.h>
#include <ArduinoJson.h>

#define SCREEN_WIDTH 128
#define SCREEN_HEIGHT 64
Adafruit_SSD1306 display(SCREEN_WIDTH, SCREEN_HEIGHT, &Wire, -1);

// Wi-Fi設定
const char* ssid = "your_SSID"; // 自分のWi-Fi SSIDに変更
const char* password = "your_PASSWORD"; // 自分のWi-Fiパスワードに変更

// API URL
const char* apiUrl = "https://api.open-meteo.com/v1/forecast?latitude=35.682839&longitude=139.759455&daily=moon_phase&timezone=Asia/Tokyo";

// タイマー関連
unsigned long previousMillis = 0;
const long interval = 86400000; // 1日（ミリ秒）

// 満月のビットマップデータ（64x64ピクセル）
// https://javl.github.io/image2cpp/
// 64x64のビットマップデータをここに追加します
// 例: 0xFF, 0x00, ... という形式で、ビットマップを作成します。
// 'moon', 64x64px
const unsigned char moonBitmap[] PROGMEM = {
	0xff, 0xff, 0xff, 0xff, 0xff, 0xff, 0xff, 0xff, 0xff, 0xff, 0xff, 0xe0, 0x05, 0xff, 0xff, 0xff,
	0xff, 0xff, 0xff, 0x00, 0x00, 0x3f, 0xff, 0xff, 0xff, 0xff, 0xf8, 0x00, 0x00, 0x07, 0xff, 0xff,
	0xff, 0xff, 0xe0, 0x00, 0x00, 0x01, 0xff, 0xff, 0xff, 0xff, 0x80, 0x00, 0x00, 0x00, 0x7f, 0xff,
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	0xff, 0xff, 0xfe, 0x00, 0x00, 0x7f, 0xff, 0xff, 0xff, 0xff, 0xff, 0xc0, 0x1f, 0xff, 0xff, 0xff
};

// Array of all bitmaps for convenience. (Total bytes used to store images in PROGMEM = 528)
const int epd_bitmap_allArray_LEN = 1;
const unsigned char* epd_bitmap_allArray[1] = {
	epd_bitmap_moon
};


void setup() {
  Serial.begin(115200);
  WiFi.begin(ssid, password);
  while (WiFi.status() != WL_CONNECTED) {
    delay(1000);
    Serial.println("Connecting to WiFi...");
  }
  Serial.println("Connected to WiFi");

  display.begin(SSD1306_SWITCHCAPVCC, 0x3C);
  display.clearDisplay();
}

void loop() {
  unsigned long currentMillis = millis();

  // 1日経過したらAPIにアクセス
  if (currentMillis - previousMillis >= interval) {
    previousMillis = currentMillis; // タイマーをリセット
    getMoonPhase();
  }
}

void getMoonPhase() {
  if (WiFi.status() == WL_CONNECTED) {
    HTTPClient http;
    http.begin(apiUrl);
    int httpCode = http.GET();

    if (httpCode > 0) {
      String payload = http.getString();
      Serial.println(payload);
      displayMoonPhase(payload); // 月の状態を表示
    } else {
      Serial.println("Error on HTTP request");
    }

    http.end();
  } else {
    Serial.println("WiFi Disconnected");
  }
}

void displayMoonPhase(String json) {
  // JSONデータを解析
  DynamicJsonDocument doc(1024);
  deserializeJson(doc, json);
  JsonObject obj = doc["daily"];

  // 月の状態を取得
  float moonPhase = obj["moon_phase"][0]; // 最新の月相データを取得（0.0〜1.0の範囲）

  // OLEDに描画
  display.clearDisplay();

  // 月のビットマップを描画
  display.drawBitmap(32, 0, moonBitmap, 64, 64, WHITE);

  // マスク処理を適用する
  int maskWidth = 64 * (1.0 - moonPhase); // 満ち欠けの割合に基づいて幅を計算

  // 欠けた部分を黒で塗りつぶす
  display.fillRect(32 + maskWidth, 0, 64 - maskWidth, 64, BLACK);

  // 月相の表示
  display.setCursor(0, 50);
  display.setTextSize(1);
  display.setTextColor(WHITE);
  display.print("Moon Phase: "); display.print(moonPhase * 100); display.println("%");

  display.display();
}
